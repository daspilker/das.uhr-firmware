## main/Kconfig.projbuild
```kconfig
menu "Configuration"
    config WIFI_SSID
        string "WiFi SSID"
        default "NichDieMama"
        help
            SSID (network name) to connect to.

    config WIFI_PASSWORD
        string "WiFi Password"
        default "changeme"
        help
            WiFi password (WPA or WPA2) to use.
            Can be left blank if the network has no security set.
endmenu
```
